#include "Arduino.h"

#include "RCS620S.h"

RCS620S felica(&Serial1);
volatile bool busy = false;

void setup(){
    Serial.begin(115200);
    while(!Serial);

    while(!felica.begin(1000));
}

void loop(){
    if(!felica.polling()){
        if(busy){
            busy = false;
        }
    }
    else if(!busy){
        uint8_t data[] = {
            0x01, 0x02, 0x2A, 0x00, 0x1D, 0x00, 0x68, 0x74,
            0x74, 0x70, 0x3A, 0x2F, 0x2F, 0x74, 0x77, 0x69,
            0x74, 0x74, 0x65, 0x72, 0x2E, 0x63, 0x6F, 0x6D,
            0x2F, 0x53, 0x44, 0x4B, 0x34, 0x46, 0x65, 0x6C,
            0x69, 0x43, 0x61, 0x46, 0x6F, 0x6C, 0x6C, 0x6F,
            0x77, 0x20, 0x4D, 0x65, 0x21, 0x21, 0xF1, 0xEE
        };

        if(felica.push(data, sizeof(data))){
            busy = true;
        }
    }

    felica.rfOff();
    delay(1000);
}